## Kconfig
```kconfig
mainmenu "RT-Thread Configuration"

BSP_DIR := .

RTT_DIR := rt-thread
LIB_DIR := libraries/HAL_Drivers
PKGS_DIR := packages

config SOC_SERIES_NS800RT7
    bool
    default y

config SOC_NS800RT7P6XX
    bool
    select SOC_SERIES_NS800RT7
    select ARCH_ARM
    select ARCH_ARM_CORTEX_M
    select ARCH_ARM_CORTEX_M7
    select RT_USING_CPU_FFS
    select RT_USING_HW_ATOMIC
    select ARCH_USING_HW_ATOMIC_8
    select ARCH_USING_HW_ATOMIC_16
    select RT_USING_COMPONENTS_INIT
    select RT_USING_USER_MAIN
    default y

config BOARD_NS800RT7P65X
    bool
    depends on SOC_NS800RT7P6XX
    default y

source "$(RTT_DIR)/Kconfig"
osource "$PKGS_DIR/Kconfig"
rsource "board/Kconfig"
rsource "$(LIB_DIR)/drivers/Kconfig"
```
